/*
 * oled.c — SSD1306 72x40 over I2C (legacy driver). Text only.
 * If the image is horizontally shifted, adjust OLED_COL_OFFSET.
 * If it's mirrored/upside-down, flip the segremap (0xA1/0xA0) and COM scan
 * (0xC8/0xC0) bytes in the init sequence.
 */
#include <string.h>
#include "oled.h"
#include "driver/i2c.h"
#include "esp_log.h"

static const char *TAG = "oled";

#define OLED_I2C_PORT   I2C_NUM_0
#define OLED_SDA        5
#define OLED_SCL        6
#define OLED_ADDR       0x3C
#define OLED_COL_OFFSET 28     /* visible window starts here in GDDRAM        */

static uint8_t s_fb[OLED_PAGES][OLED_COLS];
static bool    s_ok;

/* ---- 5x7 font, ASCII 0x20..0x5A (space..Z); others render blank ---------- */
#define FONT_FIRST 0x20
#define FONT_LAST  0x5A
static const uint8_t FONT5x7[][5] = {
    {0x00,0x00,0x00,0x00,0x00}, /* 20 space */
    {0x00,0x00,0x5F,0x00,0x00}, /* 21 ! */
    {0x00,0x00,0x00,0x00,0x00}, /* 22 */
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    {0x61,0x51,0x49,0x45,0x43}, /* 5A Z */
};

/* ---- I2C helpers -------------------------------------------------------- */
static bool cmd(uint8_t c)
{
    uint8_t b[2] = {0x00, c};   /* 0x00 = command stream */
    return i2c_master_write_to_device(OLED_I2C_PORT, OLED_ADDR, b, 2,
                                       pdMS_TO_TICKS(50)) == ESP_OK;
}

bool oled_init(void)
{
    i2c_config_t c = {
        .mode = I2C_MODE_MASTER,
        .sda_io_num = OLED_SDA, .scl_io_num = OLED_SCL,
        .sda_pullup_en = GPIO_PULLUP_ENABLE, .scl_pullup_en = GPIO_PULLUP_ENABLE,
        .master.clk_speed = 400000,
    };
    i2c_param_config(OLED_I2C_PORT, &c);
    if (i2c_driver_install(OLED_I2C_PORT, I2C_MODE_MASTER, 0, 0, 0) != ESP_OK)
        return false;

    static const uint8_t init[] = {
        0xAE, 0xD5, 0x80, 0xA8, 0x27, 0xD3, 0x00, 0x40, 0x8D, 0x14,
        0x20, 0x00, 0xA1, 0xC8, 0xDA, 0x12, 0x81, 0xAF, 0xD9, 0xF1,
        0xDB, 0x40, 0xA4, 0xA6, 0xAF,
    };
    s_ok = true;
    for (size_t i = 0; i < sizeof(init); i++) if (!cmd(init[i])) s_ok = false;
    if (!s_ok) { ESP_LOGW(TAG, "panel did not ACK — check wiring/addr"); return false; }
    oled_clear();
    oled_show();
    ESP_LOGI(TAG, "SSD1306 72x40 ready");
    return true;
}

void oled_clear(void) { memset(s_fb, 0, sizeof(s_fb)); }

void oled_str(uint8_t x, uint8_t page, const char *s)
{
    if (page >= OLED_PAGES) return;
    for (; *s && x + 5 <= OLED_COLS; s++) {
        char ch = *s;
        if (ch >= 'a' && ch <= 'z') ch -= 32;      /* uppercase only          */
        const uint8_t *g = (ch >= FONT_FIRST && ch <= FONT_LAST)
                         ? FONT5x7[ch - FONT_FIRST] : FONT5x7[0];
        for (int i = 0; i < 5; i++) s_fb[page][x + i] = g[i];
        x += 6;                                     /* 5px glyph + 1px gap     */
    }
}

void oled_line(uint8_t page, const char *s)
{
    if (page >= OLED_PAGES) return;
    memset(s_fb[page], 0, OLED_COLS);
    oled_str(0, page, s);
}

void oled_show(void)
{
    if (!s_ok) return;
    for (uint8_t p = 0; p < OLED_PAGES; p++) {
        cmd(0xB0 + p);                              /* page start              */
        cmd(0x00 + (OLED_COL_OFFSET & 0x0F));       /* lower col nibble        */
        cmd(0x10 + (OLED_COL_OFFSET >> 4));         /* higher col nibble       */
        uint8_t buf[1 + OLED_COLS];
        buf[0] = 0x40;                              /* 0x40 = data stream      */
        memcpy(&buf[1], s_fb[p], OLED_COLS);
        i2c_master_write_to_device(OLED_I2C_PORT, OLED_ADDR, buf, sizeof(buf),
                                   pdMS_TO_TICKS(50));
    }
}
